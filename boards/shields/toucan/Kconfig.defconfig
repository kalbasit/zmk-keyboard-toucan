## boards/shields/toucan/Kconfig.defconfig
```kconfig
if SHIELD_TOUCAN_LEFT

config ZMK_KEYBOARD_NAME
    default "Toucan"

config ZMK_SPLIT_ROLE_CENTRAL
    default y

config ZMK_SPLIT_BLE_CENTRAL_BATTERY_LEVEL_FETCHING
    default y

config ZMK_SPLIT_BLE_CENTRAL_BATTERY_LEVEL_PROXY
    default y

endif



if SHIELD_TOUCAN_LEFT || SHIELD_TOUCAN_RIGHT

config TOUCAN_SCROLL_DIVISOR
    int "Trackpad scroll speed divisor"
    default 5
    range 1 1000
    help
      Divisor applied to raw trackpad scroll deltas. The effective scroll
      speed is 1/TOUCAN_SCROLL_DIVISOR of the raw input. Increase this
      value to slow down scrolling (e.g. 10 = half speed, 20 = quarter
      speed vs. the default of 5).

config SPI
    default y

config ZMK_SPLIT
    default y

config ZMK_POINTING
    default y

config RGBLED_WIDGET_BATTERY_LEVEL_HIGH
    default 40

endif
```

## boards/shields/toucan/Kconfig.shield
```kconfig
config SHIELD_TOUCAN_LEFT
    def_bool $(shields_list_contains,toucan_left)

config SHIELD_TOUCAN_RIGHT
    def_bool $(shields_list_contains,toucan_right)

if SHIELD_TOUCAN_LEFT || SHIELD_TOUCAN_RIGHT

config TOUCAN_SCROLL_DIVISOR
    int "Trackpad scroll speed divisor"
    default 5
    range 1 1000
    help
      Divisor applied to raw trackpad scroll deltas. The effective scroll
      speed is 1/TOUCAN_SCROLL_DIVISOR of the raw input. Increase this
      value to slow down scrolling (e.g. 10 = half speed, 20 = quarter
      speed vs. the default of 5). Set in your zmk-config's toucan.conf.

endif # SHIELD_TOUCAN_LEFT || SHIELD_TOUCAN_RIGHT
```
